// Enable support for CLK104A board
// Attach lmx2594 driver (ADC clock) to chip-select output 0 instead of 3
//
// CLK104 uses SC18IS602, an obsolete I2C to SPI translator with 4 CS outputs.
// SPI CS mapping is:
// 1 = LMK04828
// 2 = LMX2594 (DAC clock)
// 3 = LMX2594 (ADC clock)
//
// CKL104A uses the mostly pin compatible SC18IS606, with only 3 CS outputs.
// SPI CS mapping is:
// 0 = LMX2594 (ADC clock)
// 1 = LMK04828
// 2 = LMX2594 (DAC clock)
/dts-v1/;
/plugin/;
/ {

fragment@1 {
    target = <&i2c_clk104>;
    __overlay__ {
        sc18is602@2f {
            /* 1) Disable the old node */
            lmxadc@3 {
                status = "disabled";
            };

            /* 2) Create the new node with reg = 0 */
            lmxadc@0 {
                compatible = "ti,lmx2594";
                reg = <0x0>;
                spi-max-frequency = <400000>;
                num_bytes = <3>;
                status = "okay";
            };
        };
    };
};

};
